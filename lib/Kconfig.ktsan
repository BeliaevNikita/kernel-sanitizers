## lib/Kconfig.ktsan
```kconfig
config HAVE_ARCH_KTSAN
	bool

if HAVE_ARCH_KTSAN

config KTSAN
	bool "ThreadSanitizer: dynamic data race error detector"
	default n

config KTSAN_RACE_HUNTER
	bool "RaceHunter scheduling analysis"
	depends on KTSAN
	default y

endif
```
